## manifest-repo/west.yml
```yaml
# Copyright (c) 2023 <erling.r.jellum@ntnu.no>
# Template manifest file for Lingua Franca zephyr projects

manifest:
  self:
    west-commands: scripts/west-commands.yml
    path: manifest-repo

  remotes:
    - name: zephyrproject-rtos
      url-base: https://github.com/zephyrproject-rtos

  projects:
    - name: zephyr
      remote: zephyrproject-rtos
      revision: v3.4.0
      import: 
        path-prefix: deps
```

## west.yml
```yaml
# Copyright (c) 2023 <erling.r.jellum@ntnu.no>
# Template manifest file for Lingua Franca zephyr projects

manifest:
  self:
    west-commands: scripts/west-commands.yml

  remotes:
    - name: zephyrproject-rtos
      url-base: https://github.com/zephyrproject-rtos

  projects:
    - name: zephyr
      remote: zephyrproject-rtos
      revision: v3.3.0
      import: 
        path-prefix: deps
```
